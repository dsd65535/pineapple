static const uint16_t
Rcmd[] = {0x101,
0x200,
0x111,
0x200,
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0x0C0,
0x300
},
FullScrn[] = {
0x12A,
0x000,
0x000,
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0x12C,
0x300
},
Stripes[] = {
0x007,
0x0FF,
0x0F8,
0x01F,
0x300
},
Black[] = {
0x000,
0x000,
0x300
},
White[] = {
0x0FF,
0x0FF,
0x300
};

void setup(void) {
  pinMode(8,OUTPUT);
  pinMode(9, OUTPUT);
  pinMode(10,OUTPUT);
  pinMode(11 , OUTPUT);
  pinMode(13, OUTPUT);
  digitalWrite(13,LOW);
  digitalWrite(11,LOW);
  digitalWrite(10,LOW);
  digitalWrite(9, HIGH);
  delay(500);
  digitalWrite(9, LOW);
  delay(500);
  digitalWrite(9, HIGH);
  commandList(Rcmd);
}

uint16_t i;
uint16_t kiwi;
boolean mango;

void loop() {
  int n;
  int m;
  int l;
  int k;
  commandList(FullScrn);
  for(n=0;n<72*160;n++) commandList(Stripes);
  commandList(FullScrn);
  for(n=0;n<5;n++) {
    for(m=0;m<16;m++) {
      for(l=0;l<4;l++) {
        for(k=0;k<16;k++) {
          commandList(Black);
        }
        for(k=0;k<16;k++) {
          commandList(White);
        }
      }
    }
    for(m=0;m<16;m++) {
      for(l=0;l<4;l++) {
        for(k=0;k<16;k++) {
          commandList(White);
        }
        for(k=0;k<16;k++) {
          commandList(Black);
        }
      }
    }
  }
}

void spiwrite(uint8_t c) {
  for(uint8_t bit = 0x80; bit; bit >>= 1) {
    if(c & bit) digitalWrite(11,HIGH);
    else        digitalWrite(11,LOW);
    digitalWrite(13, HIGH);
    digitalWrite(13, LOW);
  }
}

void commandList(const uint16_t *list) {
  i=0;
  mango=1;
  while(mango) {
    kiwi = list[i++];
    Serial.println(kiwi,HEX);
    if(kiwi<0x100) spiwrite(kiwi);
    else if(kiwi<0x200) {digitalWrite(8,LOW);spiwrite(kiwi);digitalWrite(8,HIGH);}
    else if(kiwi<0x300) delay(500);
    else mango=0;
  }
}
