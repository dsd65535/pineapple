


static const uint16_t
Rcmd[] = {0x101,
0x200,
0x111,
0x200,
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0x0C0,
0x300
},
Scrn[] = {
0x12A,
0x000,
0x000,
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0x12C,
0x300
},
Cyan[] = {
0x007,
0x0FF,
0x300
},
Magenta[] = {
0x0F8,
0x01F,
0x300
},
Kat[] = {
  0x0ff,
0x0ff,
0x0ff,
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0x0ff,
0x300
};

void setup(void) {
  Serial.begin(9600);
  pinMode(8,OUTPUT);
  pinMode(9, OUTPUT);
  pinMode(10,OUTPUT);
  pinMode(11 , OUTPUT);
  pinMode(13, OUTPUT);
  digitalWrite(13,LOW);
  digitalWrite(11,LOW);
  digitalWrite(10,LOW);
  digitalWrite(9, HIGH);
  delay(500);
  digitalWrite(9, LOW);
  delay(500);
  digitalWrite(9, HIGH);
  commandList(Rcmd);
  window(0,0,33,33);
  for(n=0;n<33*33;n++) {Serial.println(n); commandList(Cyan);}
}

int n;
uint16_t i;
uint16_t kiwi;
boolean mango;

void loop() {

  //commandList(Scrn);
  //for(n=0;n<128*160;n++) commandList(Magenta);
  //window(0,0,33,33);
  //for(n=0;n<1280/3;n++) commandList(Kat);
  //delay(2000);
}

void window(int16_t x,int16_t y,int16_t w,int16_t h) {
  writecommand(0x2A); // Column addr set
  writedata(0x00);
  writedata(x);     // XSTART
  writedata(0x00);
  writedata(x+w-1);     // XEND
  writecommand(0x2B); // Row addr set
  writedata(0x00);
  writedata(y);     // YSTART
  writedata(0x00);
  writedata(y+h-1);     // YEND
  writecommand(0x2C);
}
  
void writecommand(uint8_t c) {
  digitalWrite(8,LOW);
  digitalWrite(10,LOW);
  spiwrite(c);
  digitalWrite(10,HIGH);
}

void writedata(uint8_t c) {
  digitalWrite(8,HIGH);
  digitalWrite(10,LOW);
  spiwrite(c);
  digitalWrite(10,HIGH);
}

void spiwrite(uint8_t c) {
  for(uint8_t bit = 0x80; bit; bit >>= 1) {
    if(c & bit) digitalWrite(11,HIGH);
    else        digitalWrite(11,LOW);
    digitalWrite(13, HIGH);
    digitalWrite(13, LOW);
  }
}

void commandList(const uint16_t *list) {
  i=0;
  mango=1;
  while(mango) {
    kiwi = list[i++];
    Serial.println(kiwi,HEX);
    if(kiwi<0x100) spiwrite(kiwi);
    else if(kiwi<0x200) {digitalWrite(8,LOW);spiwrite(kiwi);digitalWrite(8,HIGH);}
    else if(kiwi<0x300) delay(500);
    else mango=0;
  }
}
